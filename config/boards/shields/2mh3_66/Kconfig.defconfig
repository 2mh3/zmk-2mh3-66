## config/boards/shields/2mh3_66/Kconfig.defconfig
```kconfig
if SHIELD_2MH3_66_LEFT || SHIELD_2MH3_66_RIGHT

config ZMK_KEYBOARD_NAME
    default "2mh3_66"

config ZMK_SPLIT
    default y

endif

if SHIELD_2MH3_66_LEFT

config ZMK_SPLIT_ROLE_CENTRAL
    default y

endif
```

## config/boards/shields/2mh3_66/Kconfig.shield
```kconfig
config SHIELD_2MH3_66_LEFT
    def_bool $(shields_list_contains,2mh3_66_left)

config SHIELD_2MH3_66_RIGHT
    def_bool $(shields_list_contains,2mh3_66_right)
```
