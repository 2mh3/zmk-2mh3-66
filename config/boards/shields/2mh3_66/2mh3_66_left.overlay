#include "2mh3_66.dtsi"

&kscan0 {
    // 列ピン (F7, F6, F5, F4, D7, C6, E6 -> nice!nano GPIO 18, 19, 20, 21, 5, 6, 7)
    col-gpios
        = <&pro_micro 18 GPIO_ACTIVE_HIGH>
        , <&pro_micro 19 GPIO_ACTIVE_HIGH>
        , <&pro_micro 20 GPIO_ACTIVE_HIGH>
        , <&pro_micro 21 GPIO_ACTIVE_HIGH>
        , <&pro_micro 5  GPIO_ACTIVE_HIGH>
        , <&pro_micro 6  GPIO_ACTIVE_HIGH>
        , <&pro_micro 7  GPIO_ACTIVE_HIGH>
        ;
};