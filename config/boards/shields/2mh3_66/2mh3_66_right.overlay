#include "2mh3_66.dtsi"

&kscan0 {
    col-gpios
        , <&pro_micro 18 GPIO_ACTIVE_HIGH>
        , <&pro_micro 19 GPIO_ACTIVE_HIGH>
        , <&pro_micro 20 GPIO_ACTIVE_HIGH>
        , <&pro_micro 21 GPIO_ACTIVE_HIGH>
        , <&pro_micro 6  GPIO_ACTIVE_HIGH>
        , <&pro_micro 5  GPIO_ACTIVE_HIGH>
        , <&pro_micro 7  GPIO_ACTIVE_HIGH>
        ;
};

&default_transform {
    col-offset = <7>;
};